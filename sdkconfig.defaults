## sdkconfig.defaults
```kconfig
CONFIG_BT_ENABLED=y
CONFIG_BTDM_CTRL_MODE_BLE_ONLY=y
CONFIG_BTDM_CTRL_MODE_BR_EDR_ONLY=n
CONFIG_BTDM_CTRL_MODE_BTDM=n
CONFIG_BT_BLUEDROID_ENABLED=y
CONFIG_BT_CONTROLLER_ONLY=n
CONFIG_BT_BLE_42_FEATURES_SUPPORTED=y
CONFIG_BT_BLE_BLUDROID_GATT_SERVER=y
CONFIG_BT_ACL_CONNECTIONS=1
CONFIG_BT_BLE_SMP_ENABLE=y
CONFIG_BT_BLUEDROID_PINNED_TO_CORE_0=y
CONFIG_FREERTOS_UNICORE=n
```
