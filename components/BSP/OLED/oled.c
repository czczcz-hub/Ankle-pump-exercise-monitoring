#include "oled.h"
#include "mpu6050.h"
#include "driver/i2c.h"
#include "esp_log.h"
#include <string.h>

static const char *TAG = "oled";

// SSD1306 命令
#define OLED_CMD_DISPLAY_OFF      0xAE
#define OLED_CMD_DISPLAY_ON       0xAF
#define OLED_CMD_SET_MUX_RATIO    0xA8
#define OLED_CMD_SET_DISP_OFFSET  0xD3
#define OLED_CMD_SET_DISP_START   0x40
#define OLED_CMD_SET_SEG_REMAP    0xA1
#define OLED_CMD_SET_COM_SCAN_DIR 0xC8
#define OLED_CMD_SET_COM_PINS     0xDA
#define OLED_CMD_SET_CONTRAST     0x81
#define OLED_CMD_DISP_NORMAL      0xA6
#define OLED_CMD_DISP_INVERT      0xA7
#define OLED_CMD_SET_OSC_FREQ     0xD5
#define OLED_CMD_SET_CHARGE_PUMP  0x8D
#define OLED_CMD_SET_MEM_MODE     0x20
#define OLED_CMD_SET_COL_ADDR     0x21
#define OLED_CMD_SET_PAGE_ADDR    0x22

static void oled_write_cmd(uint8_t cmd)
{
    i2c_cmd_handle_t handle = i2c_cmd_link_create();
    i2c_master_start(handle);
    i2c_master_write_byte(handle, (OLED_I2C_ADDR << 1) | I2C_MASTER_WRITE, true);
    i2c_master_write_byte(handle, 0x00, true);   // Co=0, D/C#=0 (command)
    i2c_master_write_byte(handle, cmd, true);
    i2c_master_stop(handle);
    i2c_master_cmd_begin(I2C_MASTER_PORT, handle, pdMS_TO_TICKS(50));
    i2c_cmd_link_delete(handle);
}

static void oled_write_data(const uint8_t *data, size_t len)
{
    i2c_cmd_handle_t handle = i2c_cmd_link_create();
    i2c_master_start(handle);
    i2c_master_write_byte(handle, (OLED_I2C_ADDR << 1) | I2C_MASTER_WRITE, true);
    i2c_master_write_byte(handle, 0x40, true);   // Co=0, D/C#=1 (data)
    i2c_master_write(handle, data, len, true);
    i2c_master_stop(handle);
    i2c_master_cmd_begin(I2C_MASTER_PORT, handle, pdMS_TO_TICKS(100));
    i2c_cmd_link_delete(handle);
}

// 6x8 字体, ASCII 32-126
// 每个字符 6 字节 (列扫描, 高位在下)
static const uint8_t font6x8[95][6] = {
    {0x00,0x00,0x00,0x00,0x00,0x00}, // space 32
    {0x00,0x00,0x5F,0x00,0x00,0x00}, // ! 33
    {0x00,0x07,0x00,0x07,0x00,0x00}, // " 34
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    {0x08,0x04,0x08,0x10,0x08,0x00}, // ~ 126
};

esp_err_t oled_init(void)
{
    // SSD1306 初始化序列
    oled_write_cmd(OLED_CMD_DISPLAY_OFF);
    oled_write_cmd(OLED_CMD_SET_MUX_RATIO);
    oled_write_cmd(OLED_HEIGHT - 1);
    oled_write_cmd(OLED_CMD_SET_DISP_OFFSET);
    oled_write_cmd(0x00);
    oled_write_cmd(OLED_CMD_SET_DISP_START);       // 显示起始行
    oled_write_cmd(OLED_CMD_SET_SEG_REMAP);        // 列重映射 (左右翻转)
    oled_write_cmd(OLED_CMD_SET_COM_SCAN_DIR);     // COM 扫描方向 (上下翻转)
    oled_write_cmd(OLED_CMD_SET_COM_PINS);
    oled_write_cmd(0x12);                          // 128x64 模式
    oled_write_cmd(OLED_CMD_SET_CONTRAST);
    oled_write_cmd(0x7F);
    oled_write_cmd(OLED_CMD_DISP_NORMAL);
    oled_write_cmd(OLED_CMD_SET_OSC_FREQ);
    oled_write_cmd(0x80);
    oled_write_cmd(OLED_CMD_SET_CHARGE_PUMP);
    oled_write_cmd(0x14);                          // 使能电荷泵
    oled_write_cmd(OLED_CMD_SET_MEM_MODE);
    oled_write_cmd(0x00);                          // 水平寻址模式
    oled_write_cmd(OLED_CMD_DISPLAY_ON);

    ESP_LOGI(TAG, "SSD1306 OLED initialized");
    return ESP_OK;
}

void oled_clear(void)
{
    // 设置全屏写入范围
    oled_write_cmd(OLED_CMD_SET_COL_ADDR);
    oled_write_cmd(0);
    oled_write_cmd(OLED_WIDTH - 1);
    oled_write_cmd(OLED_CMD_SET_PAGE_ADDR);
    oled_write_cmd(0);
    oled_write_cmd(OLED_PAGES - 1);

    uint8_t zero[OLED_WIDTH];
    memset(zero, 0, OLED_WIDTH);
    for (int i = 0; i < OLED_PAGES; i++) {
        oled_write_data(zero, OLED_WIDTH);
    }
}

void oled_clear_line(uint8_t line)
{
    if (line >= OLED_PAGES) return;
    oled_write_cmd(OLED_CMD_SET_COL_ADDR);
    oled_write_cmd(0);
    oled_write_cmd(OLED_WIDTH - 1);
    oled_write_cmd(OLED_CMD_SET_PAGE_ADDR);
    oled_write_cmd(line);
    oled_write_cmd(line);

    uint8_t zero[OLED_WIDTH];
    memset(zero, 0, OLED_WIDTH);
    oled_write_data(zero, OLED_WIDTH);
}

void oled_show_text_xy(uint8_t x, uint8_t page, const char *text)
{
    if (page >= OLED_PAGES) return;

    oled_write_cmd(OLED_CMD_SET_COL_ADDR);
    oled_write_cmd(x);
    oled_write_cmd(OLED_WIDTH - 1);
    oled_write_cmd(OLED_CMD_SET_PAGE_ADDR);
    oled_write_cmd(page);
    oled_write_cmd(page);

    uint8_t buf[OLED_WIDTH];
    size_t buf_idx = 0;
    while (*text && buf_idx + 6 <= OLED_WIDTH - x) {
        uint8_t ch = (uint8_t)*text;
        if (ch < 32 || ch > 126) ch = 32;
        const uint8_t *glyph = font6x8[ch - 32];
        for (int i = 0; i < 6; i++) {
            buf[buf_idx++] = glyph[i];
        }
        text++;
    }
    // 用空格填充剩余
    while (buf_idx < OLED_WIDTH) {
        buf[buf_idx++] = 0;
    }
    oled_write_data(buf, OLED_WIDTH);
}

void oled_show_text(uint8_t line, const char *text)
{
    oled_show_text_xy(0, line, text);
}
